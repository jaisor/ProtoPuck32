#include <Arduino.h>
#include "MatrixModeFireworks.h"

#ifdef LED_EXTERNAL_MATRIX

#define NUM_FIREWORKS 5
#define BITMAP_BYTES_PER_PIXEL 4
#define HAND_COLOR_MIN 0x5fff
#define HAND_COLOR_HOUR 0xfd00

const uint8_t BITMAP[] PROGMEM = {
    0x00, 0x00, 0x00, 0xff, 0x00, 0x00, 0x00, 0xff, 0x00, 0x00, 0x00, 0xff,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 0xff, 
    0x00, 0x00, 0x00, 0xff, 0x56, 0x8e, 0xf6, 0xff, 0x00, 0x00, 0x00, 0xff,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 0xff, 
    0x00, 0x00, 0x00, 0xff, 0x56, 0x8e, 0xf6, 0xff, 0x00, 0x00, 0x00, 0xff,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 0xff, 
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    0x00, 0x00, 0x00, 0xff, 0x00, 0x00, 0x00, 0xff, 0x00, 0x00, 0x00, 0xff,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 0xff, 
};

CMatrixModeFireworks::CMatrixModeFireworks(const uint8_t width, const uint8_t height)
: CBaseCanvasedMatrixMode(width, height) {
    fireworks = new CFirework*[NUM_FIREWORKS];
    for(uint8_t i=0; i<NUM_FIREWORKS; i++) {
        fireworks[i] = new CFirework(width, height);
    }
}

CMatrixModeFireworks::~CMatrixModeFireworks() {
    for(uint8_t i=0; i<NUM_FIREWORKS; i++) {
        delete fireworks[i];
    }
    delete [] fireworks;
}

void CMatrixModeFireworks::draw(CRGB *leds) {

    if (millis() - tMillis > 10) {
        tMillis = millis();
        // clear
        memset(leds, 0, width * height * sizeof(CRGB));

        for(uint8_t y=0; y<height; y++) {
            for(uint8_t x=0; x<width; x++) {
                uint8_t r, g, b;
                uint16_t bi = (y * width + x) * BITMAP_BYTES_PER_PIXEL;

                b = BITMAP[bi] * configuration.ledBrightness;
                g = BITMAP[bi+1] * configuration.ledBrightness;
                r = BITMAP[bi+2] * configuration.ledBrightness;

                leds[ XY(x, y) ] = CRGB(r, g, b);           
            }
        }
    }

    for(uint8_t i=0; i<NUM_FIREWORKS; i++) {
        fireworks[i]->draw(leds);
    }
    
}

#ifdef KEYPAD
void CMatrixModeFireworks::keyEvent(key_status_t key) {

    switch (key) { 
        case KEY_LEFT: break;
        case KEY_RIGHT: break;
        case KEY_UP: ; break;
        case KEY_DOWN: ; break;
        case KEY_MIDDLE: {
            for(uint8_t i=0; i<NUM_FIREWORKS; i++) {
                fireworks[i]->reset();
            }
        } break;
        default: ;
    }
    
}
#endif

#endif